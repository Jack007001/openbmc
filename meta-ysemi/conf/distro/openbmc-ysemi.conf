## meta-ysemi/conf/distro/openbmc-ysemi.conf
```bitbake
# require conf/distro/openbmc-phosphor.conf
require conf/distro/include/phosphor-base.inc

DISTRO_NAME = "Ysemi OpenBMC"
DISTRO_VERSION = "1.0.0"
```

## meta-ysemi/conf/layer.conf
```bitbake
# We have a conf and classes directory, add to BBPATH
BBPATH .= ":${LAYERDIR}"

# We have recipes-* directories, add to BBFILES
BBFILES += "${LAYERDIR}/meta-common/recipes-*/*/*.bb \
        ${LAYERDIR}/meta-common/recipes-*/*/*.bbappend"

BBFILE_COLLECTIONS += "ysemi"
BBFILE_PATTERN_ysemi = "^${LAYERDIR}/"
BBFILE_PRIORITY_ysemi = "6"
LAYERSERIES_COMPAT_ysemi = "dunfell gatesgarth"
LAYERDEPENDS_ysemi = "phosphor-layer"
```

## meta-ysemi/conf/machine/include/ysemi.inc
```bitbake
OBMC_MACHINE_FEATURES += "\
        obmc-host-ipmi \
        "

VIRTUAL-RUNTIME_skeleton_workbook = "${MACHINE}-config"


PREFERRED_PROVIDER_virtual/obmc-host-ipmi-hw = "phosphor-ipmi-kcs"


# add all the upstream intel override fixes
# OVERRIDES .= ":ysemi"
```

## meta-ysemi/meta-yc810/conf/layer.conf
```bitbake
# We have a conf and classes directory, add to BBPATH
BBPATH .= ":${LAYERDIR}"

# We have recipes-* directories, add to BBFILES
BBFILES += "${LAYERDIR}/recipes-*/*/*.bb \
            ${LAYERDIR}/recipes-*/*/*.bbappend"

BBFILE_COLLECTIONS += "yc810"
BBFILE_PATTERN_yc810 = "^${LAYERDIR}/"
BBFILE_PRIORITY_yc810 = "5"
LAYERSERIES_COMPAT_yc810 = "honister kirkstone"
```

## meta-ysemi/meta-yc810/conf/machine/yc810.conf
```bitbake
KMACHINE = "aspeed"
KERNEL_DEVICETREE = " \
    ${KMACHINE}-bmc-ysemi-${MACHINE}.dtb \
    "

require conf/machine/include/ast2600.inc
require conf/machine/include/obmc-bsp-common.inc
require conf/machine/include/ysemi.inc   

# Overwrite flash offsets
FLASH_UBOOT_OFFSET = "0"
FLASH_KERNEL_OFFSET = "512"
FLASH_UBI_OFFSET = "${FLASH_KERNEL_OFFSET}"
FLASH_ROFS_OFFSET = "5632"
FLASH_RWFS_OFFSET = "49152"
FLASH_SIZE = "65536"

UBOOT_MACHINE = "ast_g6_ncsi_config"

VIRTUAL-RUNTIME_skeleton_workbook = "${MACHINE}-config"
```
